# MKE18F16 register map
Vendor: Freescale Semiconductor, Inc.; Series: Kinetis_E; File version: 1.6
MKE18F16 Freescale Microcontroller
CPU: CM4 r0p1, little endian, no MPU, FPU, VTOR, 4 interrupt priority bits
Registers are 32-bit, read-write, reset 0x0 unless marked. A register's access mark holds for its fields unless they carry their own. Offsets are from the block's base; lines under a group give offsets from that group; [hi:lo] are bit positions; {n}, {i} and the like mark numbered series; 'fields as' and 'values as' point back to an identical list; <NAME> marks a mode.

## Memory map
0x00000400 FTFE_FlashConfig size 0x10 — Flash configuration field
0x40000000 AIPS size 0x84 — AIPS-Lite Bridge
0x40001000 MSCM size 0x410
0x40008000 DMA size 0x1200 — Enhanced direct memory access controller
0x4000D000 MPU size 0x820 — Memory protection unit
0x40020000 FTFE size 0x30 — Flash Memory Interface
0x40021000 DMAMUX size 0x10 — DMA channel multiplexor
0x40024000 CAN0 size 0xB80 — Flex Controller Area Network module
0x40025000 CAN1 size 0xB80 — Flex Controller Area Network module
0x40026000 FTM3 size 0xA0 — FlexTimer Module
0x40027000 ADC1 size 0xEC — Analog-to-Digital Converter
0x4002C000 LPSPI0 size 0x78 — The LPSPI Memory Map/Register Definition can be found here.
0x4002D000 LPSPI1 size 0x78 — The LPSPI Memory Map/Register Definition can be found here.
0x40031000 PDB1 size 0x198 — Programmable Delay Block
0x40032000 CRC size 0xC — Cyclic Redundancy Check
0x40033000 PDB2 size 0x198 — Programmable Delay Block
0x40036000 PDB0 size 0x198 — Programmable Delay Block
0x40037000 LPIT0 size 0x5C — Low Power Periodic Interrupt Timer (LPIT)
0x40038000 FTM0 size 0xA0 — FlexTimer Module
0x40039000 FTM1 size 0xA0 — FlexTimer Module
0x4003A000 FTM2 size 0xA0 — FlexTimer Module
0x4003B000 ADC0 size 0xEC — Analog-to-Digital Converter
0x4003C000 ADC2 size 0xEC — Analog-to-Digital Converter
0x4003D000 RTC size 0x20 — Secure Real Time Clock
0x4003F000 DAC0 size 0x24 — 12-Bit Digital-to-Analog Converter
0x40040000 LPTMR0 size 0x10 — Low Power Timer
0x40048000 SIM blocks up to offset 0x70 — System Integration Module
0x40049000 PORTA size 0xCC — Pin Control and Interrupts
0x4004A000 PORTB size 0xCC — Pin Control and Interrupts
0x4004B000 PORTC size 0xCC — Pin Control and Interrupts
0x4004C000 PORTD size 0xCC — Pin Control and Interrupts
0x4004D000 PORTE size 0xCC — Pin Control and Interrupts
0x40052000 WDOG size 0x10 — Watchdog timer
0x40056000 PWT size 0x8 — Pulse Width Timer
0x4005A000 FLEXIO size 0x510 — The FLEXIO Memory Map/Register Definition can be found here.
0x40060000 OSC32 size 0x1 — RTC Oscillator
0x40061000 EWM size 0x6 — External Watchdog Monitor
0x40062000 TRGMUX0 size 0x70 — TRGMUX
0x40063000 TRGMUX1 size 0x8 — TRGMUX
0x40064000 SCG size 0x60C — System Clock Generator
0x40065000 PCC blocks up to offset 0x1D8
0x40066000 LPI2C0 size 0x174 — The LPI2C Memory Map/Register Definition can be found here.
0x40067000 LPI2C1 size 0x174 — The LPI2C Memory Map/Register Definition can be found here.
0x4006A000 LPUART0 size 0x28 — Universal Asynchronous Receiver/Transmitter
0x4006B000 LPUART1 size 0x28 — Universal Asynchronous Receiver/Transmitter
0x4006C000 LPUART2 size 0x28 — Universal Asynchronous Receiver/Transmitter
0x40073000 CMP0 size 0xC — High-Speed Comparator (CMP), Voltage Reference (VREF) Digital-to-Analog Converter (DAC), and Analog Mux (ANMUX)
0x40074000 CMP1 size 0xC — High-Speed Comparator (CMP), Voltage Reference (VREF) Digital-to-Analog Converter (DAC), and Analog Mux (ANMUX)
0x40075000 CMP2 size 0xC — High-Speed Comparator (CMP), Voltage Reference (VREF) Digital-to-Analog Converter (DAC), and Analog Mux (ANMUX)
0x4007D000 PMC size 0x5
0x4007E000 SMC size 0x18 — System Mode Controller
0x4007F000 RCM size 0x1C — Reset Control Module
0x400FF000 GPIOA size 0x18 — General Purpose Input/Output
0x400FF040 GPIOB size 0x18 — General Purpose Input/Output
0x400FF080 GPIOC size 0x18 — General Purpose Input/Output
0x400FF0C0 GPIOD size 0x18 — General Purpose Input/Output
0x400FF100 GPIOE size 0x18 — General Purpose Input/Output
0xE0080000 MCM blocks up to offset 0x4A8 — Core Platform Miscellaneous Control Module
0xE0082000 LMEM size 0x24 — Local Memory Controller

## Interrupts
{n} DMA{n} (DMA) (n=0..15)
16 DMA_Error (DMA)
17 MCM
18 FTFE
19 Read_Collision (FTFE)
20 LVD_LVW (PMC)
21 Doublebit_Fault (FTFE)
22 WDOG_EWM (WDOG, EWM)
24 LPI2C0
25 LPI2C1
26 LPSPI0
27 LPSPI1
29 PWT
31 LPUART0_TX (LPUART0)
32 LPUART0_RX (LPUART0)
33 LPUART1_TX (LPUART1)
34 LPUART1_RX (LPUART1)
35 LPUART2_TX (LPUART2)
36 LPUART2_RX (LPUART2)
39 ADC0
40 CMP0
41 CMP1
42 FTM0
43 FTM1
44 FTM2
46 RTC
47 RTC_Seconds (RTC)
48 LPIT0
52 PDB0
56 DAC0
57 SCG_RCM (SCG)
58 LPTMR0
59 PORTA (PORTA, GPIOA)
60 PORTB (PORTB, GPIOB)
61 PORTC (PORTC, GPIOC)
62 PORTD (PORTD, GPIOD)
63 PORTE (PORTE, GPIOE)
68 PDB1
69 FLEXIO
70 CMP2
71 FTM3
73 ADC1
74 ADC2
77 PDB2
78 CAN0_ORed (CAN0)
79 CAN0_Error (CAN0)
80 CAN0_Wake_Up (CAN0)
81 CAN0_ORed_Message_buffer (CAN0)
82 CAN0_Reserved1 (CAN0)
83 CAN0_Reserved2 (CAN0)
84 CAN0_Reserved3 (CAN0)
85 CAN1_ORed (CAN1)
86 CAN1_Error (CAN1)
87 CAN1_Wake_Up (CAN1)
88 CAN1_ORed_Message_buffer (CAN1)
89 CAN1_Reserved1 (CAN1)
90 CAN1_Reserved2 (CAN1)
91 CAN1_Reserved3 (CAN1)

## Licence text in the file
Redistribution and use in source and binary forms, with or without modification, are permitted provided that the following conditions are met: o Redistributions of source code must retain the above copyright notice, this list of conditions and the following disclaimer. o Redistributions in binary form must reproduce the above copyright notice, this list of conditions and the following disclaimer in the documentation and/or other materials provided with the distribution. o Neither the name of Freescale Semiconductor, Inc. nor the names of its contributors may be used to endorse or promote products derived from this software without specific prior written permission. THIS SOFTWARE IS PROVIDED BY THE COPYRIGHT HOLDERS AND CONTRIBUTORS "AS IS" AND. ANY EXPRESS OR IMPLIED WARRANTIES, INCLUDING, BUT NOT LIMITED TO, THE IMPLIED. WARRANTIES OF MERCHANTABILITY AND FITNESS FOR A PARTICULAR PURPOSE ARE. DISCLAIMED. IN NO EVENT SHALL THE COPYRIGHT HOLDER OR CONTRIBUTORS BE LIABLE FOR. ANY DIRECT, INDIRECT, INCIDENTAL, SPECIAL, EXEMPLARY, OR CONSEQUENTIAL DAMAGES (INCLUDING, BUT NOT LIMITED TO, PROCUREMENT OF SUBSTITUTE GOODS OR SERVICES; LOSS OF USE, DATA, OR PROFITS; OR BUSINESS INTERRUPTION) HOWEVER CAUSED AND ON. ANY THEORY OF LIABILITY, WHETHER IN CONTRACT, STRICT LIABILITY, OR TORT (INCLUDING NEGLIGENCE OR OTHERWISE) ARISING IN ANY WAY OUT OF THE USE OF THIS. SOFTWARE, EVEN IF ADVISED OF THE POSSIBILITY OF SUCH DAMAGE.
