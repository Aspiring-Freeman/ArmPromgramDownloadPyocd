# M2354 register map
File version: 1.0
Registers are 32-bit, read-write, reset 0x0 unless marked. A register's access mark holds for its fields unless they carry their own. Offsets are from the block's base; [hi:lo] are bit positions; {n}, {i} and the like mark numbered series.

## PA — GPIO Register Map
Base 0x40004800
Same registers: PA_NS 0x50004800
{0x0+4i} PA{i}_PDIO (reset mask 0xFFFFFFF0) (i=0..15) — GPIO PA.n Pin Data Input/Output Register
  [0] PDIO — GPIO Px.n Pin Data Input/Output. Writing this bit can control one GPIO pin output value. Read this register to get GPIO pin status. For example, writing PA0_PDIO will reflect the written value to bit DOUT (PA_DOUT[0]), reading PA0_PDIO will return the value of PIN (PA_PIN[0]). Note 1: The writing operation will not be affected by register DATMSK (Px_DATMSK[n]). Note 2: The PC.14/PC.15/ PD.13/ PD.15/ PF.12~15/ PG.0/ PG.1/ PG.5~8/ PH.0~3/ PH.12~15 pin is ignored.
    0=Corresponding GPIO pin set to low; 1=Corresponding GPIO pin set to high

## PB — GPIO Register Map
Base 0x40004840
Same registers: PB_NS 0x50004840
{0x0+4i} PB{i}_PDIO (reset mask 0xFFFFFFF0) (i=0..15) — GPIO PB.n Pin Data Input/Output Register
  [0] PDIO — GPIO Px.n Pin Data Input/Output. Writing this bit can control one GPIO pin output value. Read this register to get GPIO pin status. For example, writing PA0_PDIO will reflect the written value to bit DOUT (PA_DOUT[0]), reading PA0_PDIO will return the value of PIN (PA_PIN[0]). Note 1: The writing operation will not be affected by register DATMSK (Px_DATMSK[n]). Note 2: The PC.14/PC.15/ PD.13/ PD.15/ PF.12~15/ PG.0/ PG.1/ PG.5~8/ PH.0~3/ PH.12~15 pin is ignored.
    0=Corresponding GPIO pin set to low; 1=Corresponding GPIO pin set to high

## PC — GPIO Register Map
Base 0x40004880
Same registers: PC_NS 0x50004880
{0x0+4i} PC{i}_PDIO (reset mask 0xFFFFFFF0) (i=0..15) — GPIO PC.n Pin Data Input/Output Register
  [0] PDIO — GPIO Px.n Pin Data Input/Output. Writing this bit can control one GPIO pin output value. Read this register to get GPIO pin status. For example, writing PA0_PDIO will reflect the written value to bit DOUT (PA_DOUT[0]), reading PA0_PDIO will return the value of PIN (PA_PIN[0]). Note 1: The writing operation will not be affected by register DATMSK (Px_DATMSK[n]). Note 2: The PC.14/PC.15/ PD.13/ PD.15/ PF.12~15/ PG.0/ PG.1/ PG.5~8/ PH.0~3/ PH.12~15 pin is ignored.
    0=Corresponding GPIO pin set to low; 1=Corresponding GPIO pin set to high

## PD — GPIO Register Map
Base 0x400048C0
Same registers: PD_NS 0x500048C0
{0x0+4i} PD{i}_PDIO (reset mask 0xFFFFFFF0) (i=0..15) — GPIO PD.n Pin Data Input/Output Register
  [0] PDIO — GPIO Px.n Pin Data Input/Output. Writing this bit can control one GPIO pin output value. Read this register to get GPIO pin status. For example, writing PA0_PDIO will reflect the written value to bit DOUT (PA_DOUT[0]), reading PA0_PDIO will return the value of PIN (PA_PIN[0]). Note 1: The writing operation will not be affected by register DATMSK (Px_DATMSK[n]). Note 2: The PC.14/PC.15/ PD.13/ PD.15/ PF.12~15/ PG.0/ PG.1/ PG.5~8/ PH.0~3/ PH.12~15 pin is ignored.
    0=Corresponding GPIO pin set to low; 1=Corresponding GPIO pin set to high

## PE — GPIO Register Map
Base 0x40004900
Same registers: PE_NS 0x50004900
{0x0+4i} PE{i}_PDIO (reset mask 0xFFFFFFF0) (i=0..15) — GPIO PE.n Pin Data Input/Output Register
  [0] PDIO — GPIO Px.n Pin Data Input/Output. Writing this bit can control one GPIO pin output value. Read this register to get GPIO pin status. For example, writing PA0_PDIO will reflect the written value to bit DOUT (PA_DOUT[0]), reading PA0_PDIO will return the value of PIN (PA_PIN[0]). Note 1: The writing operation will not be affected by register DATMSK (Px_DATMSK[n]). Note 2: The PC.14/PC.15/ PD.13/ PD.15/ PF.12~15/ PG.0/ PG.1/ PG.5~8/ PH.0~3/ PH.12~15 pin is ignored.
    0=Corresponding GPIO pin set to low; 1=Corresponding GPIO pin set to high
