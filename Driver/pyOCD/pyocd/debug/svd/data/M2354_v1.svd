# M2354 register map
File version: 1.0
M2354 SVD file
Registers are 32-bit, read-write, reset 0x0 unless marked. A register's access mark holds for its fields unless they carry their own. Offsets are from the block's base; lines under a group give offsets from that group; [hi:lo] are bit positions; {n}, {i} and the like mark numbered series; 'fields as' and 'values as' point back to an identical list; <NAME> marks a mode.

## Memory map
0x40000000 SYS blocks up to offset 0x200 — SYS Register Map
0x40000200 CLK blocks up to offset 0xB8 — CLK Register Map
0x40000300 NMI size 0x8 — NMI Register Map
0x40004000 GPIOA blocks up to offset 0x38 — GPIO Register Map
0x40004040 GPIOB blocks up to offset 0x38 — GPIO Register Map
0x40004080 GPIOC blocks up to offset 0x38 — GPIO Register Map
0x400040C0 GPIOD blocks up to offset 0x38 — GPIO Register Map
0x40004100 GPIOE blocks up to offset 0x38 — GPIO Register Map
0x40004140 GPIOF blocks up to offset 0x38 — GPIO Register Map
0x40004180 GPIOG blocks up to offset 0x38 — GPIO Register Map
0x400041C0 GPIOH blocks up to offset 0x38 — GPIO Register Map
0x40004800 PA size 0x40 — GPIO Register Map
0x40004840 PB size 0x40 — GPIO Register Map
0x40004880 PC size 0x40 — GPIO Register Map
0x400048C0 PD size 0x40 — GPIO Register Map
0x40004900 PE size 0x40 — GPIO Register Map
0x40004940 PF size 0x40 — GPIO Register Map
0x40004980 PG size 0x40 — GPIO Register Map
0x400049C0 PH size 0x40 — GPIO Register Map
0x40008000 PDMA0 blocks up to offset 0x610 — PDMA Register Map
0x40009000 USBH blocks up to offset 0x208 — USBH Register Map
0x4000C000 FMC blocks up to offset 0x110 — FMC Register Map
0x4000D000 SDH0 blocks up to offset 0x840 — SDH Register Map
0x40010000 EBI blocks up to offset 0x28 — EBI Register Map
0x40018000 PDMA1 blocks up to offset 0x610 — PDMA Register Map
0x4002F000 SCU blocks up to offset 0x210 — SCU Register Map
0x4002F500 FVC blocks up to offset 0x28 — SCU Register Map
0x4002F600 DPM blocks up to offset 0x70 — SCU Register Map
0x4002F700 PLM size 0x8 — SCU Register Map
0x40031000 CRC size 0x10 — CRC Register Map
0x40032000 CRYPTO size 0x8 — CRYPTO Register Map
0x40032008 PRNG blocks up to offset 0xF00 — CRYPTO Register Map
0x40032050 AES blocks up to offset 0xEC4 — CRYPTO Register Map
0x40032300 HMAC blocks up to offset 0xC34 — CRYPTO Register Map
0x40032800 ECC blocks up to offset 0x74C — CRYPTO Register Map
0x40032B00 RSA blocks up to offset 0x45C — CRYPTO Register Map
0x40035000 KS size 0x48 — KS Register Map
0x40040000 WDT size 0xC — WDT Register Map
0x40040100 WWDT size 0x10 — WWDT Register Map
0x40041000 RTC blocks up to offset 0x148 — RTC Register Map
0x40042000 EWDT size 0xC — EWDT Register Map
0x40042100 EWWDT size 0x10 — EWWDT Register Map
0x40043000 EADC blocks up to offset 0x134 — EADC Register Map
0x40045000 ACMP01 size 0x10 — ACMP Register Map
0x40047000 DAC blocks up to offset 0x58 — DAC Register Map
0x40048000 I2S blocks up to offset 0x28 — I2S Register Map
0x4004D000 OTG size 0x14 — OTG Register Map
0x40050000 TMR0 blocks up to offset 0xA8 — TIMER Register Map
0x40050100 TMR1 blocks up to offset 0xA8 — TIMER Register Map
0x40051000 TMR2 blocks up to offset 0xA8 — TIMER Register Map
0x40051100 TMR3 blocks up to offset 0xA8 — TIMER Register Map
0x40052000 TMR4 blocks up to offset 0xA8 — TIMER Register Map
0x40052100 TMR5 blocks up to offset 0xA8 — TIMER Register Map
0x40058000 EPWM0 blocks up to offset 0x350 — EPWM Register Map
0x40059000 EPWM1 blocks up to offset 0x350 — EPWM Register Map
0x4005A000 BPWM0 blocks up to offset 0x334 — BPWM Register Map
0x4005B000 BPWM1 blocks up to offset 0x334 — BPWM Register Map
0x40060000 QSPI0 blocks up to offset 0x34 — QSPI Register Map
0x40061000 SPI0 blocks up to offset 0x6C — SPI Register Map
0x40062000 SPI1 blocks up to offset 0x6C — SPI Register Map
0x40063000 SPI2 blocks up to offset 0x6C — SPI Register Map
0x40064000 SPI3 blocks up to offset 0x6C — SPI Register Map
0x40070000 UART0 size 0x4C — UART Register Map
0x40071000 UART1 size 0x4C — UART Register Map
0x40072000 UART2 blocks up to offset 0x4C — UART Register Map
0x40073000 UART3 blocks up to offset 0x4C — UART Register Map
0x40074000 UART4 blocks up to offset 0x4C — UART Register Map
0x40075000 UART5 blocks up to offset 0x4C — UART Register Map
0x40080000 I2C0 blocks up to offset 0x6C — I2C Register Map
0x40081000 I2C1 blocks up to offset 0x6C — I2C Register Map
0x40082000 I2C2 blocks up to offset 0x6C — I2C Register Map
0x40090000 SC0 blocks up to offset 0x50 — SC Register Map
0x40091000 SC1 blocks up to offset 0x50 — SC Register Map
0x40092000 SC2 blocks up to offset 0x50 — SC Register Map
0x400A0000 CAN blocks up to offset 0x170 — CAN Register Map
0x400B0000 QEI0 blocks up to offset 0x30 — QEI Register Map
0x400B1000 QEI1 blocks up to offset 0x30 — QEI Register Map
0x400B4000 ECAP0 size 0x20 — ECAP Register Map
0x400B5000 ECAP1 size 0x20 — ECAP Register Map
0x400B9000 TRNG blocks up to offset 0x10 — TRNG Register Map
0x400BB000 LCD blocks up to offset 0x4C — LCD Register Map
0x400BD000 TAMPER size 0x44 — Tamper Register Map
0x400C0000 USBD blocks up to offset 0x5C0 — USBD Register Map
0x400D0000 UUART0 blocks up to offset 0x68 — UUARTUART Register Map
0x400D0000 USPI0 blocks up to offset 0x68 — USCISPI Register Map
0x400D0000 UI2C0 blocks up to offset 0x90 — UI2CI2C Register Map
0x400D1000 UUART1 blocks up to offset 0x68 — UUARTUART Register Map
0x400D1000 USPI1 blocks up to offset 0x68 — USCISPI Register Map
0x400D1000 UI2C1 blocks up to offset 0x90 — UI2CI2C Register Map
0x50000000 SYS_NS blocks up to offset 0x104 — SYS Register Map
0x50000200 CLK_NS blocks up to offset 0xB8 — CLK Register Map
0x50004000 GPIOA_NS blocks up to offset 0x38 — GPIO Register Map
0x50004040 GPIOB_NS blocks up to offset 0x38 — GPIO Register Map
0x50004080 GPIOC_NS blocks up to offset 0x38 — GPIO Register Map
0x500040C0 GPIOD_NS blocks up to offset 0x38 — GPIO Register Map
0x50004100 GPIOE_NS blocks up to offset 0x38 — GPIO Register Map
0x50004140 GPIOF_NS blocks up to offset 0x38 — GPIO Register Map
0x50004180 GPIOG_NS blocks up to offset 0x38 — GPIO Register Map
0x500041C0 GPIOH_NS blocks up to offset 0x38 — GPIO Register Map
0x50004800 PA_NS size 0x40 — GPIO Register Map
0x50004840 PB_NS size 0x40 — GPIO Register Map
0x50004880 PC_NS size 0x40 — GPIO Register Map
0x500048C0 PD_NS size 0x40 — GPIO Register Map
0x50004900 PE_NS size 0x40 — GPIO Register Map
0x50004940 PF_NS size 0x40 — GPIO Register Map
0x50004980 PG_NS size 0x40 — GPIO Register Map
0x500049C0 PH_NS size 0x40 — GPIO Register Map
0x50009000 USBH_NS blocks up to offset 0x208 — USBH Register Map
0x5000C000 FMC_NS blocks up to offset 0xE4 — FMC Register Map
0x5000D000 SDH0_NS blocks up to offset 0x840 — SDH Register Map
0x50010000 EBI_NS blocks up to offset 0x28 — EBI Register Map
0x50018000 PDMA1_NS blocks up to offset 0x610 — PDMA Register Map
0x5002F000 SCU_NS blocks up to offset 0x210 — SCU Register Map
0x5002F600 DPM_NS blocks up to offset 0x70 — SCU Register Map
0x50031000 CRC_NS size 0x10 — CRC Register Map
0x50032000 CRYPTO_NS size 0x8 — CRYPTO Register Map
0x50032008 PRNG_NS blocks up to offset 0xF00 — CRYPTO Register Map
0x50032050 AES_NS blocks up to offset 0xEC4 — CRYPTO Register Map
0x50032300 HMAC_NS blocks up to offset 0xC34 — CRYPTO Register Map
0x50032800 ECC_NS blocks up to offset 0x74C — CRYPTO Register Map
0x50032B00 RSA_NS blocks up to offset 0x45C — CRYPTO Register Map
0x50042000 EWDT_NS size 0xC — EWDT Register Map
0x50042100 EWWDT_NS size 0x10 — EWWDT Register Map
0x50043000 EADC_NS blocks up to offset 0x134 — EADC Register Map
0x50045000 ACMP01_NS size 0x10 — ACMP Register Map
0x50047000 DAC_NS blocks up to offset 0x58 — DAC Register Map
0x50048000 I2S_NS blocks up to offset 0x28 — I2S Register Map
0x5004D000 OTG_NS size 0x14 — OTG Register Map
0x50051000 TMR2_NS blocks up to offset 0xA8 — TIMER Register Map
0x50051100 TMR3_NS blocks up to offset 0xA8 — TIMER Register Map
0x50052000 TMR4_NS blocks up to offset 0xA8 — TIMER Register Map
0x50052100 TMR5_NS blocks up to offset 0xA8 — TIMER Register Map
0x50058000 EPWM0_NS blocks up to offset 0x350 — EPWM Register Map
0x50059000 EPWM1_NS blocks up to offset 0x350 — EPWM Register Map
0x5005A000 BPWM0_NS blocks up to offset 0x334 — BPWM Register Map
0x5005B000 BPWM1_NS blocks up to offset 0x334 — BPWM Register Map
0x50060000 QSPI0_NS blocks up to offset 0x34 — QSPI Register Map
0x50061000 SPI0_NS blocks up to offset 0x6C — SPI Register Map
0x50062000 SPI1_NS blocks up to offset 0x6C — SPI Register Map
0x50063000 SPI2_NS blocks up to offset 0x6C — SPI Register Map
0x50064000 SPI3_NS blocks up to offset 0x6C — SPI Register Map
0x50070000 UART0_NS size 0x4C — UART Register Map
0x50071000 UART1_NS size 0x4C — UART Register Map
0x50072000 UART2_NS blocks up to offset 0x4C — UART Register Map
0x50073000 UART3_NS blocks up to offset 0x4C — UART Register Map
0x50074000 UART4_NS blocks up to offset 0x4C — UART Register Map
0x50075000 UART5_NS blocks up to offset 0x4C — UART Register Map
0x50080000 I2C0_NS blocks up to offset 0x6C — I2C Register Map
0x50081000 I2C1_NS blocks up to offset 0x6C — I2C Register Map
0x50082000 I2C2_NS blocks up to offset 0x6C — I2C Register Map
0x50090000 SC0_NS blocks up to offset 0x50 — SC Register Map
0x50091000 SC1_NS blocks up to offset 0x50 — SC Register Map
0x50092000 SC2_NS blocks up to offset 0x50 — SC Register Map
0x500A0000 CAN_NS blocks up to offset 0x170 — CAN Register Map
0x500B0000 QEI0_NS blocks up to offset 0x30 — QEI Register Map
0x500B1000 QEI1_NS blocks up to offset 0x30 — QEI Register Map
0x500B4000 ECAP0_NS size 0x20 — ECAP Register Map
0x500B5000 ECAP1_NS size 0x20 — ECAP Register Map
0x500B9000 TRNG_NS blocks up to offset 0x10 — TRNG Register Map
0x500BB000 LCD_NS blocks up to offset 0x4C — LCD Register Map
0x500C0000 USBD_NS blocks up to offset 0x5C0 — USBD Register Map
0x500D0000 UUART0_NS blocks up to offset 0x68 — UUARTUART Register Map
0x500D0000 USPI0_NS blocks up to offset 0x68 — USCISPI Register Map
0x500D0000 UI2C0_NS blocks up to offset 0x90 — UI2CI2C Register Map
0x500D1000 UUART1_NS blocks up to offset 0x68 — UUARTUART Register Map
0x500D1000 USPI1_NS blocks up to offset 0x68 — USCISPI Register Map
0x500D1000 UI2C1_NS blocks up to offset 0x90 — UI2CI2C Register Map
0xE000E000 SCS blocks up to offset 0xDE4 — SYST_SCR Register Map
0xE000E100 NVIC blocks up to offset 0x374 — NVIC Register Map
