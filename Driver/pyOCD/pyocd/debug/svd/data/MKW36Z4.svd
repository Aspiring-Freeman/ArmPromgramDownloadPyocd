# MKW36Z4 register map
Vendor: NXP Semiconductors; Series: Kinetis_W; File version: 1.6
MKW36Z4 NXP Microcontroller
CPU: CM0PLUS r0p0, little endian, no MPU, no FPU, VTOR, 2 interrupt priority bits
Registers are 16-bit, read-write, no defined reset value unless marked. A register's access mark holds for its fields unless they carry their own. Offsets are from the block's base; lines under a group give offsets from that group; [hi:lo] are bit positions; {n}, {i} and the like mark numbered series; 'fields as' and 'values as' point back to an identical list; <NAME> marks a mode.

## Memory map
0x00000400 FTFE_FlashConfig size 0x10 — Flash configuration field
0x40008000 DMA0 size 0x1080 — DMA
0x40020000 FTFE size 0x30 — Flash Memory Interface
0x40021000 DMAMUX0 size 0x4 — DMAMUX
0x40024000 CAN0 size 0xC0C — CAN
0x40029000 TRNG0 size 0xF8
0x4002C000 SPI0 size 0x8C — Serial Peripheral Interface
0x4002D000 SPI1 size 0x8C — Serial Peripheral Interface
0x40037000 PIT size 0x120
0x40038000 TPM0 size 0x88 — Timer/PWM Module
0x40039000 TPM1 size 0x88 — Timer/PWM Module
0x4003A000 TPM2 size 0x88 — Timer/PWM Module
0x4003B000 ADC0 size 0x70 — Analog-to-Digital Converter
0x4003D000 RTC size 0x20 — Secure Real Time Clock
0x40040000 LPTMR0 size 0x10 — Low Power Timer
0x40041000 RFSYS size 0x20 — System register file
0x40047000 SIM size 0x1108 — System Integration Module
0x40049000 PORTA size 0xA4 — PORT
0x4004A000 PORTB size 0xA4 — PORT
0x4004B000 PORTC size 0xA4 — PORT
0x40054000 LPUART0 size 0x20 — Universal Asynchronous Receiver/Transmitter
0x40055000 LPUART1 size 0x20 — Universal Asynchronous Receiver/Transmitter
0x40058000 LTC0 size 0x7F4 — LTC
0x40059000 RSIM size 0x130
0x4005A000 DCDC size 0x20 — DC to DC Converter
0x4005B000 BTLE_RF blocks up to offset 0x60E
0x4005C000 XCVR_RX_DIG size 0x1FC
0x4005C200 XCVR_TX_DIG size 0x1C
0x4005C224 XCVR_PLL_DIG size 0x58
0x4005C280 XCVR_MISC size 0x40
0x4005C2C0 XCVR_TSM size 0x12C
0x4005C400 XCVR_PHY size 0x34
0x4005C500 XCVR_ANALOG size 0x3C
0x4005C700 XCVR_PKT_RAM size 0x900
0x4005F000 GENFSK size 0xF80 — GENERIC FSK
0x40062000 CMT size 0xC — Carrier Modulator Transmitter
0x40064000 MCG size 0xE — Multipurpose Clock Generator module
0x40066000 I2C0 size 0xD — Inter-Integrated Circuit
0x40067000 I2C1 size 0xD — Inter-Integrated Circuit
0x40073000 CMP0 size 0x6 — High-Speed Comparator (CMP), Voltage Reference (VREF) Digital-to-Analog Converter (DAC), and Analog Mux (ANMUX)
0x40074000 VREF size 0x2 — Voltage Reference
0x4007C000 LLWU size 0xA — Low leakage wakeup unit
0x4007D000 PMC size 0x3 — Power Management Controller
0x4007E000 SMC size 0x4 — System Mode Controller
0x4007F000 RCM size 0x6 — Reset Control Module
0x400FF000 GPIOA size 0x18 — General Purpose Input/Output
0x400FF040 GPIOB size 0x18 — General Purpose Input/Output
0x400FF080 GPIOC size 0x18 — General Purpose Input/Output
0xF0000000 MTB size 0x1000 — Micro Trace Buffer
0xF0001000 MTBDWT size 0x1000 — MTB data watchpoint and trace
0xF0002000 ROM size 0x1000 — System ROM
0xF0003000 MCM blocks up to offset 0x44 — Core Platform Miscellaneous Control Module
0xF8000000 FGPIOA size 0x18 — General Purpose Input/Output
0xF8000040 FGPIOB size 0x18 — General Purpose Input/Output
0xF8000080 FGPIOC size 0x18 — General Purpose Input/Output

## Interrupts
5 FTFE
6 LVD_LVW_DCDC (DCDC, PMC)
7 LLWU
8 I2C0
9 I2C1
10 SPI0
12 LPUART0_LPUART1 (LPUART0, LPUART1)
13 TRNG0
14 CMT
15 ADC0
16 CMP0
17 TPM0
18 TPM1
19 TPM2
20 RTC
21 RTC_Seconds (RTC)
23 LTC0
27 MCG
28 LPTMR0
29 SPI1
30 PORTA (GPIOA)
31 PORTB_PORTC (GPIOB, GPIOC)

## Licence text in the file
The Clear BSD License. Copyright 2016-2018 NXP. All rights reserved. Redistribution and use in source and binary forms, with or without modification, are permitted (subject to the limitations in the disclaimer below) provided that the following conditions are met: * Redistributions of source code must retain the above copyright notice, this list of conditions and the following disclaimer. * Redistributions in binary form must reproduce the above copyright notice, this list of conditions and the following disclaimer in the documentation and/or other materials provided with the distribution. * Neither the name of the copyright holder nor the names of its contributors may be used to endorse or promote products derived from this software without specific prior written permission. NO EXPRESS OR IMPLIED LICENSES TO ANY PARTY'S PATENT RIGHTS ARE. GRANTED BY THIS LICENSE. THIS SOFTWARE IS PROVIDED BY THE COPYRIGHT. HOLDERS AND CONTRIBUTORS "AS IS" AND ANY EXPRESS OR IMPLIED. WARRANTIES, INCLUDING, BUT NOT LIMITED TO, THE IMPLIED WARRANTIES OF. MERCHANTABILITY AND FITNESS FOR A PARTICULAR PURPOSE ARE. DISCLAIMED. IN NO EVENT SHALL THE COPYRIGHT HOLDER OR CONTRIBUTORS BE. LIABLE FOR ANY DIRECT, INDIRECT, INCIDENTAL, SPECIAL, EXEMPLARY, OR. CONSEQUENTIAL DAMAGES (INCLUDING, BUT NOT LIMITED TO, PROCUREMENT OF. SUBSTITUTE GOODS OR SERVICES; LOSS OF USE, DATA, OR PROFITS; OR. BUSINESS INTERRUPTION) HOWEVER CAUSED AND ON ANY THEORY OF LIABILITY, WHETHER IN CONTRACT, STRICT LIABILITY, OR TORT (INCLUDING NEGLIGENCE. OR OTHERWISE) ARISING IN ANY WAY OUT OF THE USE OF THIS SOFTWARE, EVEN. IF ADVISED OF THE POSSIBILITY OF SUCH DAMAGE.
